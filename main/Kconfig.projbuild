## main/Kconfig.projbuild
```kconfig
menu "My Configuration"

    config FORMAT_IF_MOUNT_FAILED
        bool "Format the file system if mount fails"
        default y
        help
            If this option is checked, the flash will be formatted if mounting fails.
            This is normally the case when the flash is used for the first time.
endmenu
```
